## boards/arm/urban_power_4g/Kconfig
```kconfig
if BOARD_URBAN_POWER_4G

config BOARD_ENABLE_DCDC
	bool "DCDC mode"
	select SOC_DCDC_NRF52X
	default y

config BOARD_ENABLE_DCDC_HV
	bool "High Voltage DCDC converter"
	select SOC_DCDC_NRF52X_HV
	default y
	depends on SOC_NRF52840_QIAA

endif # BOARD_URB_POWER_4G
```

## boards/arm/urban_power_4g/Kconfig.board
```kconfig
config BOARD_URBAN_POWER_4G
    bool "urban_power_4g"
	depends on SOC_NRF52840_QIAA 
```

## boards/arm/urban_power_4g/board.yml
```yaml
board:
  name: urban_power_4g
  vendor: unknown
  socs:
    - name: nrf52840
  revision:
    format: major.minor.patch
    default: 3.5.0
    exact: true
    revisions:
      - name: 0.99.0
      - name: 1.0.1
      - name: 3.5.0
```

## boards/arm/urban_power_4g/urban_power_4g_defconfig
```kconfig
CONFIG_SOC_SERIES_NRF52X=y
CONFIG_SOC_NRF52840_QIAA=y
CONFIG_BOARD_URBAN_POWER_4G=y

# Enable MPU
CONFIG_ARM_MPU=y

# Enable hardware stack protection
CONFIG_HW_STACK_PROTECTION=y

# enable pin controller
CONFIG_PINCTRL=y

# Need this when storage is on flash
CONFIG_MPU_ALLOW_FLASH_WRITE=y

CONFIG_GPIO=y
```

## libs/Kconfig
```kconfig
menu "libs_project"

menuconfig LIBS_PROJECT
    bool "Enable project libraries"
    help
      Project-scoped library support.

if LIBS_PROJECT
rsource "mqtt/Kconfig"
rsource "drivers/Kconfig"
endif

endmenu
```

## libs/drivers/Kconfig
```kconfig
menuconfig LIBS_MODEM
    bool "Project's supported modems"
    select MODEM
    help
        List of nisse supported modems

if LIBS_MODEM
rsource "modem/Kconfig"
endif
```

## libs/drivers/modem/Kconfig.lynq-l5xx
```kconfig
# LYNQ L5XX driver options

config MODEM_LYNQ_L5XX
	bool "Enable lynq modem driver"
	select MODEM_CONTEXT
	select MODEM_CMD_HANDLER
	select MODEM_IFACE_UART
	select NET_SOCKETS_OFFLOAD
	help
	  Choose this setting to enable LYNQ L5XX LTE-CatM1/NB-IoT modem
	  driver.

if MODEM_LYNQ_L5XX

config MODEM_LYNQ_L5XX_RX_STACK_SIZE
	int "Stack size for the LYNQ L5XX modem driver RX thread"
	default 1028
	help
	  This stack is used by the LYNQ L5XX RX thread.

config MODEM_LYNQ_L5XX_INIT_PRIORITY
	int "LYNQ L5XX driver init priority"
	default 80
	help
	  LYNQ L5XX device driver initialization priority.
	  Do not mess with it unless you know what you are doing.
	  Note that the priority needs to be lower than the net stack
	  so that it can start before the networking sub-system.

endif
```

## libs/dts/bindings/modem/lynq,l5xx.yaml
```yaml
description: lynq l5xx modem

compatible: "lynq,l5xx"

include: uart-device.yaml

properties:
  mdm-power-gpios:
    type: phandle-array
    required: true

  mdm-reset-gpios:
    type: phandle-array

  mdm-dtr-gpios:
    type: phandle-array
```

## libs/mqtt/Kconfig
```kconfig
menuconfig LIBS_MQTT
    bool "Enable MQTT library support"
    depends on MQTT
    depends on MQTT_CLEAN_SESSION
    default n

if LIBS_MQTT

config LIBS_MQTT_MAX_CLIENT_SUPPORT
    int "Max number of concurrent clients that this library supports"
    default 1

config LIBS_MQTT_MAX_HOST_LENGTH
    int "Max host name length permissible"
    default 64

config LIBS_MQTT_MAX_CLIENT_ID_LENGTH
    int "Max client id length permissible"
    default 32

config LIBS_MQTT_MAX_USERNAME_LENGTH
    int "Max username length permissible"
    default 32

config LIBS_MQTT_MAX_PASSWORD_LENGTH
    int "Max password length permissible"
    default 32

config LIBS_MQTT_MAX_TOPIC_LENGTH
    int "Max topic length permissible"
    default 128

endif # LIBS_MQTT

if LIBS_MQTT

module = LIBS_MQTT
module-str = LIBS_MQTT
source "subsys/logging/Kconfig.template.log_config"

endif # LIBS_MQTT
```

## tests/modem_shell_test/Kconfig
```kconfig
module = APPLICATION
module-str = APPLICATION
source "subsys/logging/Kconfig.template.log_config"

source "Kconfig.zephyr"
```
